## boards/ESP32/XIAO_ESP32S3/Kconfig
```kconfig
config CHIP_CHOICE
    string
    default "esp32s3"

config BOARD_CHOICE
    string
    default "XIAO_ESP32S3"

config BOARD_CONFIG
    bool
    default y
    select ENABLE_AUDIO
    select ENABLE_AUDIO_CODECS
    select ENABLE_BUTTON
    select ENABLE_LED
    select ENABLE_ESP_DISPLAY
    select PLATFORM_FLASHSIZE_8M
    select ENABLE_ESP32S3_USB_JTAG_ONLY
    select BOARD_AUDIO_PDM_MIC
    select BOARD_AUDIO_I2S_SPEAKER

config BOARD_AUDIO_PDM_MIC
    bool "Use XIAO Sense onboard PDM microphone (GPIO41/42)"
    default y
    ---help---
        XIAO ESP32S3 Sense expansion board wires the digital mic to
        PDM DATA=GPIO41 and CLK=GPIO42. Disable only when using an
        external I2S mic on D3/D4/D5 instead.

config BOARD_AUDIO_I2S_SPEAKER
    bool "Enable MAX98357A I2S speaker on D3/D4/D5 (GPIO4/5/6)"
    default y
    depends on BOARD_AUDIO_PDM_MIC
    ---help---
        Use I2S1 TX to drive an external MAX98357A (or similar) amp:
        BCLK=D4/GPIO5, LRC=D3/GPIO4, DIN=D5/GPIO6, SD=3V3.

config UART_NUM0_TX_PIN
    int "UART_NUM0_TX_PIN"
    range 0 44
    default 43
    ---help---
        XIAO ESP32S3 USB CDC TX (D6)

config UART_NUM0_RX_PIN
    int "UART_NUM0_RX_PIN"
    range 0 44
    default 44
    ---help---
        XIAO ESP32S3 USB CDC RX (D7)
```

## boards/ESP32/XTEINK_X4/Kconfig
```kconfig
config CHIP_CHOICE
    string
    default "esp32c3"

config BOARD_CHOICE
    string
    default "XTEINK_X4"

config BOARD_CONFIG
    bool
    default y
    select PLATFORM_FLASHSIZE_4M
    ---help---
        XTEINK X4 uses ESP32-C3 with 4MB SPI flash.

config UART_NUM0_TX_PIN
    int "UART_NUM0_TX_PIN"
    range 0 21
    default 18
    ---help---
        Xteink X4 uses GPIO20 for USB charge sense; avoid UART on GPIO20/21 if possible.
        Default 18 may be used for console when USB-CDC is not the log output.

config UART_NUM0_RX_PIN
    int "UART_NUM0_RX_PIN"
    range 0 21
    default 19
    ---help---
        Paired with UART_NUM0_TX_PIN for UART0.
```

## boards/LINUX/ssd2355/Kconfig
```kconfig
menu "SigmaStar SSD2355 (glibc) Board Configuration"
    config CHIP_CHOICE
        string
        default "ssd2355"

    config BOARD_CHOICE
        string
        default "ssd2355"

    config BOARD_CONFIG
        bool
        default y
        select ENABLE_QRCODE

    config ENABLE_EXT_RAM
        default n

    config LINUX_USE_LIBC_MALLOC
        default y

    config ENABLE_KEYBOARD_INPUT
        bool "Enable keyboard input for SSD2355"
        default n
        ---help---
            Enable keyboard input handling. Press the configured key on the
            serial/stdin console to trigger a conversation. Useful when the
            board has no physical button wired.

    config BUTTON_NAME
        string "Keyboard button device value"
        depends on ENABLE_KEYBOARD_INPUT
        default "s"
        ---help---
            Specify the keyboard button character used for input handling.
endmenu
```

## boards/T5AI/TUYA_T5AI_CORE/Kconfig
```kconfig
config CHIP_CHOICE
    string
    default "T5AI"

config BOARD_CHOICE
    string
    default "TUYA_T5AI_CORE"

config BOARD_CONFIG
    bool
    default y
    select ENABLE_AUDIO_CODECS
    select ENABLE_AUDIO_AEC
    select ENABLE_LED
    select ENABLE_BUTTON

choice TUYA_T5AI_CORE_EX_MODULE
    prompt "choose expansion module for TUYA_T5AI_CORE"
    default TUYA_T5AI_CORE_EX_MODULE_NONE

    config TUYA_T5AI_CORE_EX_MODULE_NONE
        bool "no expansion module"

    config TUYA_T5AI_CORE_EX_MODULE_13565LCD
        bool "1.54 inch 240x240 spi LCD"
        select ENABLE_DISPLAY

    config TUYA_T5AI_CORE_EX_MODULE_ST7735S_XLT
        bool "ST7735S XLT 160x80 spi LCD"
        select ENABLE_DISPLAY
endchoice
```
